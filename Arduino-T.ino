#include <SPI.h>
#include <Wire.h>
String Hour, Minute;
bool IsBeep;
String Buffer = "";
const static String Version = "B151026";
void ReadLine() {
  while (Serial.available() > 0)
  {
    Buffer += char(Serial.read());
    delay(2);
  }
}
class Script {
  private:
    String Body;
    char Tmp[16];

    void Init()
    {
      for (uint8_t i = 0; i < 16; i++) {
        Tmp[i] = 0;
      }
    }

    void Split()
    {
      int i, j;
      for (i = 0; Body.charAt(i) != '.'; i++)
        Tmp[i] = Body.charAt(i);
      Blocks[0] = Tmp;
      Init();
      j = i + 1;
      for (i += 1; Body.charAt(i) != '<'; i++)
        Tmp[i - j] = Body.charAt(i);
      Blocks[1] = Tmp;
      Init();
      j = i + 1;
      for (i += 1; Body.charAt(i) != '>'; i++)
        Tmp[i - j] = Body.charAt(i);
      Blocks[2] = Tmp;
      Init();
      j = i + 2;
      for (i += 2; Body.charAt(i) != ')'; i++)
        Tmp[i - j] = Body.charAt(i);
      Blocks[3] = Tmp;
      Init();
    }

  public:
    String Blocks[4];

    Script(String Content)
    {
      Init();

      Body = "";
      for (int i = 0; i < 4; i++)
        Blocks[i] = "";

      Body = Content;
      Split();
    }
};
Script* spt;

#include <Mirf.h>
#include <Mirf_nRF24L01.h>
#include <MirfHardwareSpiDriver.h>
int GET() {
  int data;
  if (!Mirf.isSending() && Mirf.dataReady()) {
    Mirf.getData((byte *)&data);
    Mirf.setTADDR((byte *)"CRCSS");
    Mirf.send((byte *)data);
    return data;
  } else {
    return 0;
  }
}
void SET(int data) {
  int tmp = 0;
  unsigned long t = millis();
  Mirf.setTADDR((byte *)"CRCSS");  
  Mirf.send((byte *)&data);
  while(Mirf.isSending()){
  }
  //Serial.println("Finished sending");
  delay(10);
  while(!Mirf.dataReady()){
    if ( ( millis() - t ) > 1000 ) {
      //Serial.println("tout on response from server!");
      return;
    }
  }
  Mirf.getData((byte *) &tmp);  
}

#define BEEP_PIN 9
void Beep(int msLength) {
  for (int i = 0; i < msLength * 2; i++) {
    digitalWrite(BEEP_PIN, HIGH);
    delayMicroseconds(250);
    digitalWrite(BEEP_PIN, LOW);
    delayMicroseconds(250);
  }
}

void Beep(int msLength, int Height) {
  for (int i = 0; i < Height / 2; i++) {
    digitalWrite(BEEP_PIN, HIGH);
    delayMicroseconds(msLength * 1000 / Height);
    digitalWrite(BEEP_PIN, LOW);
    delayMicroseconds(msLength * 1000 / Height);
  }
}

#include "DHT.h"
#define DHTTYPE DHT11
#define DHTAPIN 4
#define DHTBPIN 5
DHT DhtA(DHTAPIN, DHTTYPE);
DHT DhtB(DHTBPIN, DHTTYPE);

#include <Adafruit_BMP085.h>
Adafruit_BMP085 Bmp;

#include <MFRC522.h>
#define RFID_RST 44
#define RFID_SS  6
MFRC522 RFID(RFID_SS, RFID_RST);
MFRC522::MIFARE_Key RFIDKey;
byte TmpUid[10];
void GetRFID(byte *buffer, byte bufferSize) {
  for (byte i = 0; i < bufferSize; i++) {
    Serial.print(buffer[i], HEX);
  }
}

#include <Adafruit_GFX.h>
#include <Adafruit_SSD1351.h>
#define OLED_DC  2
#define OLED_CS  3
#define OLED_RST 53
#define BLACK   0x0000
#define BLUE    0x001F
#define RED     0xF800
#define GREEN   0x07E0
#define CYAN    0x07FF
#define MAGENTA 0xF81F
#define YELLOW  0xFFE0
#define WHITE   0xFFFF
Adafruit_SSD1351 OLED = Adafruit_SSD1351(OLED_CS, OLED_DC, OLED_RST);
uint16_t GetColor565(uint32_t RGB)
{
  uint8_t r, g, b;

  b = (RGB >> (0 + 3)) & 0x1f;
  g = (RGB >> (8 + 2)) & 0x3f;
  r = (RGB >> (16 + 3)) & 0x1f;

  return ((r << 11) + (g << 5) + (b << 0));
}
void DrawString(uint8_t x, uint8_t y, char *text, uint16_t color) {
  OLED.setCursor(x, y);
  OLED.setTextColor(color);
  OLED.print(text);
}
void DrawString(uint8_t x, uint8_t y, String text, uint16_t color) {
  OLED.setCursor(x, y);
  OLED.setTextColor(color);
  OLED.print(text);
}
const static uint8_t PROGMEM NSDN_LOGO[] =
{
  0x00, 0x00, 0x00, 0x00, 0x00, 0x00, 0x00, 0x00, 0x00, 0x00, 0x00, 0x00, 0x00, 0x00, 0x00, 0x00,
  0x00, 0x00, 0x00, 0x00, 0x00, 0x00, 0x00, 0x00, 0x00, 0x00, 0x00, 0x00, 0x00, 0x00, 0x00, 0x00,
  0x00, 0x00, 0x00, 0x00, 0x00, 0x00, 0x00, 0x00, 0x00, 0x00, 0x00, 0x00, 0x00, 0x00, 0x00, 0x00,
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  0x00, 0x00, 0x00, 0x00, 0x00, 0x00, 0x00, 0x00, 0x00, 0x00, 0x00, 0x00, 0x00, 0x00, 0x00, 0x00
};

void setup(void) {
  Serial.begin(9600);
  while (!Serial);
  SPI.begin();

  pinMode(BEEP_PIN, OUTPUT);

  for (uint8_t i = 30; i <= 35; i++) {
    pinMode(i, OUTPUT);
    digitalWrite(i, LOW);
  }  

  Serial.println("Start.");
  OLED.begin();
//  OLED.fillScreen(BLACK);
//  OLED.drawBitmap(0, 0, NSDN_LOGO, 128, 128, CYAN);
//  DrawString(0, 121, "CRCS-T " + Version, WHITE);
  delay(2000);

  if (!Bmp.begin()) {
//    DrawString(0, 0, "Oooops", RED);
    Beep(100);
    delay(100);
    Beep(100);
    delay(100);
    Beep(100);
    delay(100);
  }

  RFID.PCD_Init();
  for (byte i = 0; i < 6; i++) {
    RFIDKey.keyByte[i] = 0xFF;
  }

  Mirf.spi = &MirfHardwareSpi;
  Mirf.init();
  Mirf.setRADDR((byte *)"CRCST");
  Mirf.payload = sizeof(int);
  Mirf.config();

  delay(2000);
//  OLED.fillScreen(MAGENTA);
  Beep(100);
}

void loop() {
  //OLED.setCursor(0, 0);

  ReadLine();
  Serial.flush();
  if (Buffer == "set.bool<main>(YES)\n") {
    Serial.println("set.bool<main>(YES)");

    Serial.print("set.float<HumiA>(");
    Serial.print(DhtA.readHumidity());
    Serial.println(")");
    Serial.print("set.float<TemperA>(");
    Serial.print(DhtA.readTemperature());
    Serial.println(")");

    Serial.print("set.float<HumiB>(");
    Serial.print(DhtB.readHumidity());
    Serial.println(")");
    Serial.print("set.float<TemperB>(");
    Serial.print(DhtB.readTemperature());
    Serial.println(")");

    Serial.print("set.float<TemperC>(");
    Serial.print(Bmp.readTemperature());
    Serial.println(")");
    Serial.print("set.float<Pressure>(");
    Serial.print((float)Bmp.readPressure() / 1000.0);
    Serial.println(")");

    Serial.println("set.bool<main>(NOP)");

    Serial.print("set.int<CardUid>(");
    GetRFID(TmpUid, RFID.uid.size);
    Serial.println(")");
  } else if (Buffer.length() > 0) {
    spt = new Script(Buffer);

    if (spt->Blocks[0] == "get") {
    }
    else if (spt->Blocks[0] == "set") {
      if (spt->Blocks[1] == "bool") {
        if (spt->Blocks[2] == "Beep") {
          if (spt->Blocks[3] == "YES")
            IsBeep = 1;
          else IsBeep = 0;
        }
        else if (spt->Blocks[2] == "30") {
          if (spt->Blocks[3] == "YES")
            digitalWrite(30, HIGH);
          else digitalWrite(30, LOW);
        }
        else if (spt->Blocks[2] == "31") {
          if (spt->Blocks[3] == "YES")
            digitalWrite(31, HIGH);
          else digitalWrite(31, LOW);
        }
        else if (spt->Blocks[2] == "32") {
          if (spt->Blocks[3] == "YES")
            digitalWrite(32, HIGH);
          else digitalWrite(32, LOW);
        }
        else if (spt->Blocks[2] == "33") {
          if (spt->Blocks[3] == "YES")
            digitalWrite(33, HIGH);
          else digitalWrite(33, LOW);
        }
        else if (spt->Blocks[2] == "34") {
          if (spt->Blocks[3] == "YES")
            digitalWrite(34, HIGH);
          else digitalWrite(34, LOW);
        }
        else if (spt->Blocks[2] == "35") {
          if (spt->Blocks[3] == "YES")
            digitalWrite(35, HIGH);
          else digitalWrite(35, LOW);
        }
        else if (spt->Blocks[2] == "Light") {
        }
      }
      else if (spt->Blocks[1] == "int") {
      }
      else if (spt->Blocks[1] == "float") {
      }
      else if (spt->Blocks[1] == "time") {
        Hour = spt->Blocks[2];
        Minute = spt->Blocks[3];
      }
    }
  }
  Buffer = "";

//  OLED.fillScreen(MAGENTA);
//
//  OLED.setTextColor(WHITE);
//  OLED.println(Hour + ":" + Minute);
  if (IsBeep) Beep(500, 100);

  if (GET() == 1) Serial.println("set.int<HandUp>(1)");
  delay(1000);

  if (RFID.PICC_IsNewCardPresent())
    if (RFID.PICC_ReadCardSerial()) {
      for (uint8_t i = 0; i < RFID.uid.size; i++)
        TmpUid[i] = RFID.uid.uidByte[i];
      Beep(500);
//      OLED.fillScreen(GREEN);
      RFID.PICC_HaltA();
      RFID.PCD_StopCrypto1();
      //delay(1000);
    }

  if (Hour.toInt() == 0) SET(2400);
  else SET(Hour.toInt() * 100);
  delay(1000);
  if (Minute.toInt() == 0) SET(60);
  else SET(Minute.toInt());

}
